## sources/videology-distro/conf/layer.conf
```bitbake
# We have a conf and classes directory, add to BBPATH
BBPATH .= ":${LAYERDIR}"

# We have a packages directory, add to BBFILES
BBFILES += "\
        ${LAYERDIR}/recipes-*/*/*.bb \
        ${LAYERDIR}/recipes-*/*/*.bbappend \
        ${LAYERDIR}/recipes-*/*/*/*.bb \
        ${LAYERDIR}/recipes-*/*/*/*.bbappend \
"
BBMASK_append_use-mainline-bsp = "\
        .*/recipes-videology-bsp/.* \
"

BBFILE_COLLECTIONS += "videology-distro"
BBFILE_PATTERN_videology-distro := "^${LAYERDIR}/"
BBFILE_PRIORITY_videology-distro = "6"
BBFILE_PRIORITY_videology-distro_use-nxp-bsp = "12"

LAYERDEPENDS_videology-distro_use-mainline-bsp = "karo"
LAYERDEPENDS_videology-distro_use-nxp-bsp = "videology-bsp"
LAYERSERIES_COMPAT_videology-distro = "hardknott"

FILESYSTEM_PERMS_TABLES = "meta/files/fs-perms.txt"
```

## videology-bsp-karo/conf/layer.conf
```bitbake
# We have a conf and classes directory, add to BBPATH
BBPATH .= ":${LAYERDIR}"

# We have a packages directory, add to BBFILES
BBFILES += "${LAYERDIR}/recipes-*/*/*.bb \
            ${LAYERDIR}/recipes-*/*/*.bbappend"

BBFILE_COLLECTIONS += "videology-bsp"
BBFILE_PATTERN_videology-bsp := "^${LAYERDIR}/"
BBFILE_PRIORITY_videology-bsp = "12"

LAYERDEPENDS_videology-bsp = "core networking-layer meta-python"
LAYERSERIES_COMPAT_videology-bsp = "kirkstone mickledore"
```

## videology-bsp-karo/conf/machine/include/tx8m-base.inc
```bitbake
KBUILD_BUILD_USER := "support"
KBUILD_BUILD_HOST := "karo-electronics.de"

MACHINEOVERRIDES =. "mx8:mx8m:"

BUILD_REPRODUCIBLE_BINARIES ?= "0"
INHERIT:remove = "${@'reproducible_build' if d.getVar('BUILD_REPRODUCIBLE_BINARIES') == '0' else ''}"

require conf/machine/include/imx-base.inc
require conf/machine/include/arm/armv8a/tune-cortexa53.inc

SOC_PREFIX = "imx8m"

SOC_FAMILY ??= ""
SOC_FAMILY:mx8mm-nxp-bsp = "imx8mm"
SOC_FAMILY:mx8mn-nxp-bsp = "imx8mn"
SOC_FAMILY:mx8mp-nxp-bsp = "imx8mp"
MACHINEOVERRIDES =. "${@ "${SOC_FAMILY}:" if "${SOC_FAMILY}" != "" else ""}"

MACHINE_FEATURES += "emmc"
MACHINE_FEATURES:remove = "nxp8987"

MACHINE_USES_VIVANTE_KERNEL_DRIVER_MODULE = "0"
MACHINE_HAS_VIVANTE_KERNEL_DRIVER_SUPPORT = "1"

KARO_BOARD_PMIC ?= "bd71847"

UBOOT_CONFIG ??= "noenv mfg default"
UBOOT_FEATURES ??= ""

# Set U-Boot DTB
KARO_BASEBOARD ??= ""
UBOOT_DTB_NAME = "${@ "${DTB_BASENAME}%s.dtb" % ("-${KARO_BASEBOARD}" if "${KARO_BASEBOARD}" != "" else "")}"

BOOT_TOOLS = "imx-boot-tools"

SPL_BINARY = "spl/u-boot-spl.bin"

# Set imx-mkimage boot target
IMXBOOT_TARGETS ?= "flash_tx8m"
IMX_BOOT_SOC_TARGET ?= "iMX8MM"
ATF_PLATFORM ?= "imx8mm"
ATF_LOAD_ADDR ?= "0x920000"

# Set Serial console
SERIAL_CONSOLES ?= "115200;ttymxc0 115200;ttymxc1 115200;ttymxc2"
# for imx-atf
IMX_BOOT_UART_BASE ?= "0x30860000"

# Set DDR FIRMWARE
DDR_FIRMWARE_NAME ?= " \
        ddr3_imem_1d.bin \
        ddr3_dmem_1d.bin \
"

IMAGE_BOOTLOADER = "imx-boot-karo"

LOADADDR = ""
UBOOT_SUFFIX = "bin"
UBOOT_MAKE_TARGET = ""

IMX_DEFAULT_BSP = "nxp"
PREFERRED_PROVIDER_virtual/bootloader = "u-boot-karo"
# PREFERRED_PROVIDER_virtual/kernel = "linux-karo"
PREFERRED_PROVIDER_imx-boot = "imx-boot-karo"

PREFERRED_PROVIDER_ptpd = "ptpd"

# Blacklist evbug kernel module
KERNEL_MODULE_PROBECONF += "evbug"
module_conf_evbug = "blacklist evbug"
```

## videology-bsp-karo/conf/machine/mx8-camera-desktop.conf
```bitbake
MACHINE="mx8-camera"
require conf/machine/mx8-camera.conf

require conf/machine/include/ubuntubasics.inc
```

## videology-bsp-karo/conf/machine/mx8-camera.conf
```bitbake
#@TYPE: Machine
#@NAME: Videology imx8 based camera device
#@SOC: i.MX8MP
#@DESCRIPTION: Machine configuration for Videology imx8 amera based on the KAro QSXP-ML81
#@VERSION: 1

MACHINEOVERRIDES =. "mx8-camera:"

require conf/machine/qsxp-ml81.conf

# Set U-Boot DTB
UBOOT_DTB_NAME = "imx8mp-qsxp-ml81-qsbase3.dtb"

PREFERRED_PROVIDER_virtual/dtb ?= "karo-devicetrees"

MACHINE_ESSENTIAL_EXTRA_RDEPENDS += "karo-devicetrees"

# MACHINE_FEATURES += "optee"
MACHINE_FEATURES:remove = "wifi bluetooth"

KARO_BASEBOARD = ""
WKS_FILE ?= "${SOC_DEFAULT_WKS_FILE}"
RM_WORK_EXCLUDE += "u-boot-imx u-boot-karo linux-karo linux-imx kernel-module-crosslink-lvds2mipi"

# devicetrees are supplied from recipe.
KERNEL_DEVICETREE:mx8-camera = ""
KERNEL_DEVICETREE = ""
# defconfig will be supplied
KBUILD_DEFCONFIG:mx8-camera = ""

# # UBOOT_CONFIG[mx8-camera] = "mx8-camera_config"
# UBOOT_CONFIG[default] = "mx8-camera_config"
# UBOOT_CONFIG ??= "mfg default"
# UBOOT_CONFIG[mfg] = "mx8-camera_mfg_config"
UBOOT_CONFIG ??= "default mfg noenv"

IMAGE_CLASSES += " uuu-loader-image "
IMAGE_FSTYPES:remove = "sdcard.bz2 wic.bz2 wic.bmap"

# # use wic image with boot partition derived from /boot folder in rootfs.
# ######################################################################################
# SOC_DEFAULT_WKS_FILE:mx8-camera ?= "imx-boot-split-rootfs.wks.in"
# # remove kernel from image.
# RRECOMMENDS:${KERNEL_PACKAGE_NAME}-base = ""
# # add initramfs
# INITRAMFS_IMAGE_BUNDLE = '1'
# MACHINE_ESSENTIAL_EXTRA_RDEPENDS += "kernel-initramfs"
# IMAGE_CLASSES += "link_default_dtb"
# ######################################################################################
# use wic image with boot partition derived from IMAGE_BOOT_FILES in deployDir
######################################################################################
SOC_DEFAULT_WKS_FILE:mx8-camera ?= "imx-boot-part-rootfs.wks.in"
IMAGE_BOOT_FILES = "devicetree/*;devicetree/ ${KERNEL_IMAGETYPE}-${INITRAMFS_LINK_NAME}${KERNEL_IMAGE_BIN_EXT};${KERNEL_IMAGETYPE}-initramfs "
# remove kernel from image.
RRECOMMENDS:${KERNEL_PACKAGE_NAME}-base = ""
INITRAMFS_IMAGE_BUNDLE = '1'
######################################################################################

# IMXBOOT_TARGETS = "flash_evk"

# overrides imx-base.inc?
WKS_FILE_DEPENDS:append:mx8 = " ${IMAGE_BOOTLOADER}"
WKS_FILE_DEPENDS:append:mx8m = " ${IMAGE_BOOTLOADER}"

WKS_FILE_DEPENDS:remove = "imx-boot"

PREFERRED_PROVIDER_virtual/bootloader = "u-boot-karo"
PREFERRED_RPROVIDER_u-boot-default-env = "u-boot-karo"
PREFERRED_PROVIDER_virtual/bootloader:mx8-camera = "u-boot-karo"

UBOOT_MACHINE ?= ""
```

## videology-bsp-karo/conf/machine/qsxm-mm60.conf
```bitbake
#@TYPE: Machine
#@NAME: Ka-Ro electronics NXP i.MX8MM QSXM-MM60 Computer-On-Module
#@SOC: i.MX8MM
#@DESCRIPTION: Machine configuration for Ka-Ro electronics QSXM-MM60 Computer-On-Module
#@MAINTAINER: Ka-Ro electronics GmbH <support@karo-electronics.com>
#@VERSION: 1
#@DATE: 2020-01-20

MACHINEOVERRIDES =. "qsxm:mx8mm:"

require include/tx8m-base.inc

KARO_BOARD_PMIC = "pca9450"

IMXBOOT_TARGETS = "flash_tx8m_lpddr4"

# Set DDR FIRMWARE
DDR_FIRMWARE_NAME = " \
        lpddr4_pmu_train_1d_imem.bin \
        lpddr4_pmu_train_1d_dmem.bin \
        lpddr4_pmu_train_2d_imem.bin \
        lpddr4_pmu_train_2d_dmem.bin \
"

# u-boot configs
UBOOT_CONFIG[default] = "qsxm-mm60_config"
UBOOT_CONFIG[noenv] = "qsxm-mm60_noenv_config"
UBOOT_CONFIG[mfg] = "qsxm-mm60_mfg_config"
UBOOT_CONFIG[secure-boot] = "qsxm-mm60_sec_config"

IMX_BOOT_SEEK = "33"
```

## videology-bsp-karo/conf/machine/qsxp-ml81.conf
```bitbake
#@TYPE: Machine
#@NAME: Ka-Ro electronics NXP i.MX8MP QSXP-ML81 Computer-On-Module
#@SOC: i.MX8MP
#@DESCRIPTION: Machine configuration for Ka-Ro electronics QSXP-ML81 Computer-On-Module
#@MAINTAINER: Ka-Ro electronics GmbH <support@karo-electronics.com>
#@VERSION: 1
#@DATE: 2020-08-10

MACHINEOVERRIDES =. "qsxp:mx8mp:"

require include/tx8m-base.inc

KARO_BOARD_PMIC = "pca9450"

IMXBOOT_TARGETS = "flash_tx8m_lpddr4"
IMX_BOOT_SOC_TARGET = "iMX8MP"
IMX_BOOT_UART_BASE ?= "0x30890000"
SPL_BINARY = "spl/u-boot-spl.bin"

# Set DDR FIRMWARE
DDR_FIRMWARE_NAME = " \
        lpddr4_pmu_train_1d_dmem_202006.bin \
        lpddr4_pmu_train_1d_imem_202006.bin \
        lpddr4_pmu_train_2d_dmem_202006.bin \
        lpddr4_pmu_train_2d_imem_202006.bin \
"

# u-boot configs
UBOOT_CONFIG[default] = "qsxp-ml81_config"
UBOOT_CONFIG[noenv] = "qsxp-ml81_noenv_config"
UBOOT_CONFIG[mfg] = "qsxp-ml81_mfg_config"
UBOOT_CONFIG[secure-boot] = "qsxp-ml81_sec_config"

IMX_BOOT_SEEK = "32"
ATF_PLATFORM = "imx8mp"
ATF_LOAD_ADDR = "0x970000"
```

## videology-bsp-karo/conf/machine/scailx-imx8mp-desktop.conf
```bitbake
MACHINE="scailx-imx8mp"
require conf/machine/scailx-imx8mp.conf

require conf/machine/include/ubuntubasics.inc
```

## videology-bsp-karo/conf/machine/scailx-imx8mp.conf
```bitbake
#@TYPE: Machine
#@NAME: Videology imx8 based camera device
#@SOC: i.MX8MP
#@DESCRIPTION: Machine configuration for Videology imx8 amera based on the KAro QSXP-ML81
#@VERSION: 1

MACHINEOVERRIDES =. "scailx-imx8mp:"

require conf/machine/qsxp-ml81.conf

# Set U-Boot DTB
UBOOT_DTB_NAME = "imx8mp-qsxp-ml81-qsbase3.dtb"

PREFERRED_PROVIDER_virtual/dtb ?= "karo-devicetrees"

MACHINE_ESSENTIAL_EXTRA_RDEPENDS += "karo-devicetrees"

MACHINE_FEATURES += "optee"
MACHINE_FEATURES:remove = "wifi bluetooth"

KARO_BASEBOARD = ""
WKS_FILE ?= "${SOC_DEFAULT_WKS_FILE}"
RM_WORK_EXCLUDE += "u-boot-imx u-boot-karo linux-karo linux-imx kernel-module-crosslink-lvds2mipi"

# devicetrees are supplied from recipe.
KERNEL_DEVICETREE:scailx-imx8mp = ""
KERNEL_DEVICETREE = ""
# defconfig will be supplied
KBUILD_DEFCONFIG:scailx-imx8mp = ""

# # UBOOT_CONFIG[scailx-imx8mp] = "scailx-imx8mp_config"
# UBOOT_CONFIG[default] = "scailx-imx8mp_config"
# UBOOT_CONFIG ??= "mfg default"
# UBOOT_CONFIG[mfg] = "scailx-imx8mp_mfg_config"
UBOOT_CONFIG ??= "default mfg noenv"

IMAGE_CLASSES += " uuu-loader-image "
IMAGE_FSTYPES:remove = "sdcard.bz2 wic.bz2 wic.bmap"

# # use wic image with boot partition derived from /boot folder in rootfs.
# ######################################################################################
# SOC_DEFAULT_WKS_FILE:scailx-imx8mp ?= "imx-boot-split-rootfs.wks.in"
# # remove kernel from image.
# RRECOMMENDS:${KERNEL_PACKAGE_NAME}-base = ""
# # add initramfs
# INITRAMFS_IMAGE_BUNDLE = '1'
# MACHINE_ESSENTIAL_EXTRA_RDEPENDS += "kernel-initramfs"
# IMAGE_CLASSES += "link_default_dtb"
# ######################################################################################
# use wic image with boot partition derived from IMAGE_BOOT_FILES in deployDir
######################################################################################
# DEFAULT_DTB ??= "scailx_karo.dtb"
SOC_DEFAULT_WKS_FILE:scailx-imx8mp ?= "imx-boot-part-rootfs.wks.in"
IMAGE_BOOT_FILES = "devicetree/*;bsp1/devicetree/ \
            devicetree/scailx_karo.dtb;bsp1/devicetree/default.dtb \
            devicetree/scailx_karo.dtb;default.dtb \
            ${KERNEL_IMAGETYPE}-${INITRAMFS_LINK_NAME}${KERNEL_IMAGE_BIN_EXT};bsp1/${KERNEL_IMAGETYPE}-initramfs \
            boot.scr boot.scr;slot1 \
            "
# remove kernel from image.
RRECOMMENDS:${KERNEL_PACKAGE_NAME}-base = ""
INITRAMFS_IMAGE_BUNDLE = '1'
######################################################################################

# IMXBOOT_TARGETS = "flash_evk"

# overrides imx-base.inc?
WKS_FILE_DEPENDS:append:mx8 = " ${IMAGE_BOOTLOADER}"
WKS_FILE_DEPENDS:append:mx8m = " ${IMAGE_BOOTLOADER}"

WKS_FILE_DEPENDS:remove = "imx-boot"

PREFERRED_PROVIDER_virtual/bootloader = "u-boot-karo"
PREFERRED_RPROVIDER_u-boot-default-env = "u-boot-karo"
PREFERRED_PROVIDER_virtual/bootloader:scailx-imx8mp = "u-boot-karo"

UBOOT_MACHINE ?= ""

OVERLAYFS_MOUNT_POINT[storage] = "/storage"
EXTRA_IMAGEDEPENDS += "imx-boot"
```

## videology-distro/conf/distro/scailx-ubuntu.conf
```bitbake
# i.MX DISTRO for Wayland with X11

require conf/distro/imx-desktop-xwayland.conf

# allow BSP devices to programamtically add uboot env vars
INHERIT += "scailx-uboot-env-vars"

# Remove conflicting backends
# DISTRO_FEATURES:remove = "directfb "
# DISTRO_FEATURES:append = " x11 wayland pam"

# DISTRO = "scailx-ubuntu"
# DISTRO_NAME = "Yocto Linux for Scailx"
# DISTRO_VERSION = "22.04.0.8"
# DISTRO_CODENAME = "scailx-ubuntu"

# PREFERRED_RPROVIDER_network-configuration ??= "networkd-dhcp-conf"

# PACKAGECONFIG:remove:pn-btrfs-tools = "python convert"
INITRAMFS_IMAGE = "initramfs-scailx"

SCAILX_VERSION ?= "0.8.5"
SCAILX_UBOOT_VERSION ?= "2020.04_0.1"

VOLATILE_BINDS += "/storage/containers /var/lib/docker\n"
EXTRA_ROOTFS_DIRS += "/var/lib/docker"

KERNEL_CLASSES += "kernel-initramfs-compress"

# PACKAGE_FEED_GPG_PASSPHRASE_FILE ?= "/work/share/scailx-ppa-key-pass.txt"
# PACKAGE_FEED_GPG_NAME ?= "scailx-ppa-key"
# INHERIT += "${@'sign_package_feed' if os.path.isfile(d.getVar('PACKAGE_FEED_GPG_PASSPHRASE_FILE')) else ''}"
```

## videology-distro/conf/distro/scailx.conf
```bitbake
# i.MX DISTRO for Wayland with X11
include conf/distro/fsl-imx-xwayland.conf

# allow BSP devices to programamtically add uboot env vars
INHERIT += "scailx-uboot-env-vars"

DISTRO_FEATURES:append = " systemd"
DISTRO = "scailx"
DISTRO_NAME = "Yocto Linux for Scailx"
DISTRO_VERSION ?= "0.9.1"
DISTRO_CODENAME = "scailx"

PREFERRED_RPROVIDER_network-configuration ??= "networkd-dhcp-conf"
VIRTUAL-RUNTIME_container_runtime ??= "crun"

# PACKAGECONFIG:remove:pn-btrfs-tools = "python convert"

# add plugins-bad packages for webrtc, srtp, etc.
PACKAGECONFIG:append:pn-gstreamer1.0-plugins-bad = " webrtc webrtcdsp dtls sctp srtp "
PACKAGECONFIG_REMOVE:remove:pn-gstreamer1.0-plugins-bad = " dtls "

INITRAMFS_IMAGE ?= "initramfs-scailx"

SCAILX_VERSION ?= "${DISTRO_VERSION}"
SCAILX_UBOOT_VERSION ?= "2020.04_0.1"

VOLATILE_BINDS += "/storage/containers /var/lib/docker\n"
EXTRA_ROOTFS_DIRS += "/var/lib/docker"

KERNEL_CLASSES += "kernel-initramfs-compress"

DISTROOVERRIDES:append = ":scailx"

KERNEL_FEATURES:append:scailx = " cfg/modules-unload.cfg cfg/of-configfs.cfg cfg/imu2_fragment.cfg cfg/gsml_fragment.cfg cfg/remove-tuners.cfg "
KERNEL_FEATURES:append:scailx = " ${@bb.utils.contains('DISTRO_FEATURES', 'virtualization', ' cfg/podman.cfg', '', d)} "

PACKAGE_FEED_GPG_PASSPHRASE_FILE ?= "/work/share/scailx-ppa-key-pass.txt"
PACKAGE_FEED_GPG_NAME ?= "scailx-ppa-key"
INHERIT += "${@'sign_package_feed' if os.path.isfile(d.getVar('PACKAGE_FEED_GPG_PASSPHRASE_FILE')) else ''}"
```
