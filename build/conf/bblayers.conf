## build/conf/bblayers.conf
```bitbake
LCONF_VERSION = "7"

BBPATH = "${TOPDIR}"
BSPDIR := "${@os.path.abspath(os.path.dirname(d.getVar('FILE', True)) + '/../..')}"

BBFILES ?= ""
BBLAYERS = " \
  ${BSPDIR}/sources/poky/meta \
  ${BSPDIR}/sources/poky/meta-poky \
  \
  ${BSPDIR}/sources/meta-openembedded/meta-oe \
  ${BSPDIR}/sources/meta-openembedded/meta-filesystems \
  ${BSPDIR}/sources/meta-openembedded/meta-networking \
  ${BSPDIR}/sources/meta-openembedded/meta-multimedia \
  ${BSPDIR}/sources/meta-openembedded/meta-python \
  ${BSPDIR}/sources/meta-qt5 \
  ${BSPDIR}/sources/meta-python2 \
  \
  ${BSPDIR}/sources/meta-freescale \
  ${BSPDIR}/sources/meta-freescale-distro \
"

# i.MX Yocto Project Release layers
BBLAYERS += "${BSPDIR}/sources/meta-imx/meta-bsp"
BBLAYERS += "${BSPDIR}/sources/meta-imx/meta-sdk"
BBLAYERS += "${BSPDIR}/sources/meta-imx/meta-ml"
BBLAYERS += "${BSPDIR}/sources/meta-nxp-demo-experience"
BBLAYERS += "${BSPDIR}/sources/meta-openembedded/meta-gnome"

# Ka-Ro specific layers
BBLAYERS += "${BSPDIR}/sources/meta-karo-nxp"
# BBLAYERS += "${BSPDIR}/sources/meta-karo-distro"

# Basler layers
BBLAYERS += "${BSPDIR}/sources/meta-basler-imx8"
BBLAYERS += "${BSPDIR}/sources/meta-basler-tools/meta-basler-common"

# Videology layers
BBLAYERS += "${BSPDIR}/sources/videology-bsp-karo"
BBLAYERS += "${BSPDIR}/sources/videology-distro"
```

## build/conf/local.conf
```bitbake
MACHINE ??= 'mx8-camera'
DL_DIR ?= "${BSPDIR}/downloads"
SSTATE_DIR ?= "${BSPDIR}/sstate-cache"
DISTRO ?= 'karo-xwayland'
DISTRO_FEATURES_append = " alternatives-symlinks-relative"
PACKAGE_CLASSES ?= "package_rpm"
EXTRA_IMAGE_FEATURES ?= "debug-tweaks"
USER_CLASSES ?= "buildstats image-mklibs image-prelink"
PATCHRESOLVE = "noop"
BB_DISKMON_DIRS ??= "\
    STOPTASKS,${TMPDIR},1G,100K \
    STOPTASKS,${DL_DIR},1G,100K \
    STOPTASKS,${SSTATE_DIR},1G,100K \
    STOPTASKS,/tmp,100M,100K \
    ABORT,${TMPDIR},100M,1K \
    ABORT,${DL_DIR},100M,1K \
    ABORT,${SSTATE_DIR},100M,1K \
    ABORT,/tmp,10M,1K"


PACKAGECONFIG_append_pn-qemu-native = " sdl"
PACKAGECONFIG_append_pn-nativesdk-qemu = " sdl"
CONF_VERSION = "1"
VIRTUAL-RUNTIME_dev_manager ??= "udev"
ROOT_HOME = "/root"
SANITY_TESTED_DISTROS_append = " devuan"
ACCEPT_FSL_EULA = "1"

INHERIT += "rm_work"
```

## sources/meta-basler-imx8/conf/layer.conf
```bitbake
# We have a conf and classes directory, add to BBPATH
BBPATH .= ":${LAYERDIR}"

# We have recipes-* directories, add to BBFILES
BBFILES += "${LAYERDIR}/recipes-*/*/*.bb \
         ${LAYERDIR}/recipes-*/*/*.bbappend"

BBFILE_COLLECTIONS += "basler-imx8"
BBFILE_PATTERN_basler-imx8 = "^${LAYERDIR}/"
BBFILE_PRIORITY_basler-imx8 = "50"
LAYERVERSION_basler-imx8 = "1"
LAYERSERIES_COMPAT_basler-imx8 = "hardknott"

# Override/extend machine configurations

# imx8mmddr4evk
KERNEL_DEVICETREE_append_imx8mmddr4evk = " \
  freescale/imx8mm-ddr4-evk-basler-camera.dtb"

# imx8mmevk
KERNEL_DEVICETREE_append_imx8mmevk = " \
  freescale/imx8mm-evk-basler-camera.dtb"

# imx8mqevk
KERNEL_DEVICETREE_append_imx8mqevk = " \
  freescale/imx8mq-evk-basler-camera-csi1.dtb \
  freescale/imx8mq-evk-basler-camera-csi2.dtb \
  freescale/imx8mq-evk-basler-camera.dtb"

# imx8mpevk
KERNEL_DEVICETREE_append_imx8mpevk = " \
  freescale/imx8mp-evk-basler.dtb \
  freescale/imx8mp-evk-dual-basler.dtb \
  freescale/imx8mp-evk-basler-mixed-isp-isi.dtb  \
  freescale/imx8mp-evk-basler-isi0-isi1.dtb  \
  freescale/imx8mp-evk-basler-isi0.dtb "

# qsxp
KERNEL_DEVICETREE_append_qsxp-ml81 = " \
  freescale/imx8mp-qsxp-ml81-qsbase3-basler.dtb \
"

# qsxm
KERNEL_DEVICETREE_append_qsxm-mm60 = " \
  freescale/imx8mm-qsxm-mm60-qsbase3-basler.dtb \
"
```

## sources/meta-basler-tools/meta-basler-common/conf/layer.conf
```bitbake
# We have a conf and classes directory, add to BBPATH
BBPATH .= ":${LAYERDIR}"

# We have recipes-* directories, add to BBFILES
BBFILES += " ${LAYERDIR}/recipes-*/*/*.bb ${LAYERDIR}/recipes-*/*/*.bbappend"

BBFILE_COLLECTIONS += "basler-common"
BBFILE_PATTERN_basler-common = "^${LAYERDIR}/"
BBFILE_PRIORITY_basler-common = "50"
LAYERVERSION_basler-common = "2"
LAYERSERIES_COMPAT_basler-common = "sumo thud warrior zeus hardknott"

LICENSE_PATH += "${LAYERDIR}/licenses"
```

## sources/meta-basler-tools/meta-basler-demo-image/conf/layer.conf
```bitbake
# We have a conf and classes directory, add to BBPATH
BBPATH .= ":${LAYERDIR}"

# We have recipes-* directories, add to BBFILES
BBFILES += "${LAYERDIR}/recipes-*/*/*.bb \
         ${LAYERDIR}/recipes-*/*/*.bbappend"

BBFILE_COLLECTIONS += "basler-demo-image"
BBFILE_PATTERN_basler-demo-image = "^${LAYERDIR}/"
BBFILE_PRIORITY_basler-demo-image = "50"
LAYERVERSION_basler-demo-image = "1"
LAYERSERIES_COMPAT_basler-demo-image = "hardknott"
```

## sources/videology-bsp-karo/conf/machine/include/tx8m-base.inc
```bitbake
KBUILD_BUILD_USER := "support"
KBUILD_BUILD_HOST := "karo-electronics.de"

MACHINEOVERRIDES =. "mx8:mx8m:tx8m:"

BUILD_REPRODUCIBLE_BINARIES ?= "0"
INHERIT_remove = "${@'reproducible_build' if d.getVar('BUILD_REPRODUCIBLE_BINARIES') == '0' else ''}"

# IMAGE_CLASSES += "st-partitions-image"

require conf/machine/include/imx-base.inc
require conf/machine/include/tune-cortexa53.inc

MACHINE_FEATURES += "emmc"
MACHINE_FEATURES_remove = "nxp8987"

MACHINE_USES_VIVANTE_KERNEL_DRIVER_MODULE = "0"
MACHINE_HAS_VIVANTE_KERNEL_DRIVER_SUPPORT = "1"

KARO_BOARD_PMIC ?= "bd71847"

UBOOT_CONFIG ??= "noenv mfg default"
BOOT_TOOLS = "imx-boot-tools"

SPL_BINARY = "spl/u-boot-spl.bin"

# Set imx-mkimage boot target
IMXBOOT_TARGETS ?= "flash_tx8m"
IMX_BOOT_SOC_TARGET ?= "iMX8MM"
ATF_PLATFORM ?= "imx8mm"
ATF_LOAD_ADDR ?= "0x920000"

# Set Serial console
SERIAL_CONSOLES = "115200;ttymxc0 115200;ttymxc1 115200;ttymxc2"
# for imx-atf
IMX_BOOT_UART_BASE ?= "0x30860000"

# Set DDR FIRMWARE
DDR_FIRMWARE_NAME ?= " \
        ddr3_imem_1d.bin \
        ddr3_dmem_1d.bin \
"

IMAGE_BOOTLOADER = "imx-boot-karo"

LOADADDR = ""
UBOOT_SUFFIX = "bin"
UBOOT_MAKE_TARGET = ""

IMX_DEFAULT_BSP = "nxp"
PREFERRED_PROVIDER_virtual/bootloader_imx = "u-boot-imx"
PREFERRED_PROVIDER_virtual/kernel_imx = "linux-imx"

PREFERRED_PROVIDER_ptpd = "ptpd"

# Blacklist evbug kernel module
KERNEL_MODULE_PROBECONF += "evbug"
module_conf_evbug = "blacklist evbug"
```

## sources/videology-bsp-karo/conf/machine/mx8-camera.conf
```bitbake
#@TYPE: Machine
#@NAME: Videology imx8 based camera device
#@SOC: i.MX8MP
#@DESCRIPTION: Machine configuration for Videology imx8 amera based on the KAro QSXP-ML81
#@VERSION: 1

MACHINEOVERRIDES =. "mx8-camera:"

require conf/machine/qsxp-ml81.conf

# Set U-Boot DTB
UBOOT_DTB_NAME = "imx8mp-qsxp-ml81-qsbase3.dtb"

PREFERRED_PROVIDER_virtual/dtb ?= "karo-devicetrees"

MACHINE_ESSENTIAL_EXTRA_RDEPENDS += "karo-devicetrees"

# devicetrees are supplied from recipe.
KERNEL_DEVICETREE_mx8-camera = ""
# defconfig will be supplied
KBUILD_DEFCONFIG_mx8-camera = ""

# UBOOT_CONFIG[mx8-camera] = "mx8-camera_config"
UBOOT_CONFIG[default] = "mx8-camera_config"
UBOOT_CONFIG ??= "mfg default"
UBOOT_CONFIG[mfg] = "mx8-camera_mfg_config"
IMAGE_CLASSES += " uuu-loader-image "
IMAGE_FSTYPES_remove = "sdcard.bz2 wic.bz2 wic.bmap"
IMAGE_FSTYPES += 'uuuimg wic'
SOC_DEFAULT_WKS_FILE_mx8-camera ?= "imx-boot-rootfs.wks.in"

# IMXBOOT_TARGETS = "flash_evk"

# overrides imx-base.inc?
WKS_FILE_DEPENDS_append_mx8 = " ${IMAGE_BOOTLOADER}"
WKS_FILE_DEPENDS_append_mx8m = " ${IMAGE_BOOTLOADER}"

WKS_FILE_DEPENDS_remove = "imx-boot"
```
