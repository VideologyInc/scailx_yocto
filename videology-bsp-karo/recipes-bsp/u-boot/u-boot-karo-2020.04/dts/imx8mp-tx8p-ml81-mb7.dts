// SPDX-License-Identifier: (GPL-2.0 OR MIT)
/*
 * Copyright (C) 2023 Lothar Waßmann <LW@KARO-electronics.de>
 *
 */

#include "imx8mp-tx8p-ml81.dts"
#include "imx8mp-tx8p-lvds-mb.dtsi"

/ {
	model = "Ka-Ro TX8P-ML81 module on MB7 baseboard";
};
