// SPDX-License-Identifier: (GPL-2.0 OR MIT)
/*
 * Copyright (C) 2020 Markus Bauer <mb@karo-electronics.de>
 *
 */

/dts-v1/;

#include "imx8mp-qsxp-ml81.dts"
#include "imx8mp-qsxp-ml81-camera.dtsi"

/ {
	model = "Ka-Ro electronics QSXP-ML81 module on Videology Camera";
};
