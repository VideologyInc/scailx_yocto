// SPDX-License-Identifier: (GPL-2.0 OR MIT)
/*
 * Copyright (C) 2023 VideologyInc
 *
 */

/dts-v1/;
/plugin/;

#include <dt-bindings/clock/imx8mp-clock.h>
#include <dt-bindings/gpio/gpio.h>

&{/chosen} {
	overlays {
		vpu_v4l = __TIMESTAMP__;
	};
};

&vpu_v4l2 {
	status = "okay";
};


