## videology-distro/conf/layer.conf
```bitbake
# We have a conf and classes directory, add to BBPATH
BBPATH .= ":${LAYERDIR}"

# We have a packages directory, add to BBFILES
BBFILES += "\
        ${LAYERDIR}/recipes-*/*/*.bb \
        ${LAYERDIR}/recipes-*/*/*.bbappend \
        ${LAYERDIR}/recipes-*/*/*/*.bb \
        ${LAYERDIR}/recipes-*/*/*/*.bbappend \
"
BBMASK:append:use-mainline-bsp = "\
        .*/recipes-videology-bsp/.* \
"

BBFILE_COLLECTIONS += "videology-distro"
BBFILE_PATTERN_videology-distro := "^${LAYERDIR}/"
BBFILE_PRIORITY_videology-distro = "10"

LAYERDEPENDS_videology-distro_use-mainline-bsp = "karo"
LAYERDEPENDS_videology-distro_use-nxp-bsp = "videology-bsp"
LAYERSERIES_COMPAT_videology-distro = "kirkstone mickledore nanbield"

FILESYSTEM_PERMS_TABLES = "meta/files/fs-perms.txt"

DISTRO_FEATURES_DEFAULT:remove = "\
        3g \
        bluetooth \
        nfc \
        pcmcia \
        wifi \
"

SCAILX_SOURCES ??= ""
# DISTRO_FEATURES:append = " overlayfs"

BBFILES_DYNAMIC += " \
    imx-machine-learning:${LAYERDIR}/dynamic-layers/meta_ml/recipes-*/*/*.bb \
    imx-machine-learning:${LAYERDIR}/dynamic-layers/meta_ml/recipes-*/*/*.bbappend \
    meta-ml:${LAYERDIR}/dynamic-layers/meta_ml/recipes-*/*/*.bb \
    meta-ml:${LAYERDIR}/dynamic-layers/meta_ml/recipes-*/*/*.bbappend \
    \
    virtualization-layer:${LAYERDIR}/dynamic-layers/virtualization-layer/*/*/*.bb \
    virtualization-layer:${LAYERDIR}/dynamic-layers/virtualization-layer/*/*/*.bbappend \
    \
    swupdate:${LAYERDIR}/dynamic-layers/meta_swupdate/*/*/*.bb \
    swupdate:${LAYERDIR}/dynamic-layers/meta_swupdate/*/*/*.bbappend \
    \
    meta-hailo-accelerator:${LAYERDIR}/dynamic-layers/hailo/*/*/*.bb \
    meta-hailo-accelerator:${LAYERDIR}/dynamic-layers/hailo/*/*/*.bbappend \
    \
    desktop-distro:${LAYERDIR}/dynamic-layers/meta-nxp-desktop/*/*/*.bb \
    desktop-distro:${LAYERDIR}/dynamic-layers/meta-nxp-desktop/*/*/*.bbappend \
"

VOLATILE_BINDS:append = "/storage/config /config\n"

MACHINE_ESSENTIAL_EXTRA_RDEPENDS += "udev-rules-scailx"

SCAILX_SCRIPTS_DIRS = "${@ ':'.join(s+'/scailx_scripts' for s in '${BBPATH}'.split(':')) }"

PREFERRED_VERSION_libgpiod ?= "1.6.%"

IMAGE_CLASSES += "image-docker-archive"
```
